// Golden vectors for tests/test_colour_luminance.py, produced by the pinned
// FastLED itself rather than by a description of it.
//
// The clock writes `CRGB(CHSV(hue, sat, 255))` (LedDriverWS2812FastLED.cpp,
// setColorHS), which is FastLED's *rainbow* wheel - not geometric HSV, not
// sRGB HSV. Its saturation and value branches carry the library's own integer
// scaling (`scale8` with FASTLED_SCALE8_FIXED, `scale8_video`), and every one
// of those roundings shows up in the drive values the sensor model needs. A
// Python reimplementation is only worth anything if it matches this file.
//
// Two more mappings ride along because they are the same kind of fact and the
// same kind of mistake: the clock's own 0..359 / 0..100 to byte conversion in
// `main .cpp`, and `_gammaScale()` / `_brightnessScaleColor()` in the driver -
// the latter compiled here with the float arithmetic the ESP32 uses, so a
// Python `double` that disagrees is caught.
//
// The vectors describe arithmetic, not optics: no `stackId` belongs on them.
// A change of optical stack changes the fitted weights and the coupling map,
// not what CHSV(140, 200, 255) converts to.
//
// Build and run. FASTLED is PlatformIO's own checkout of the pinned library -
// `.pio/libdeps/seeed_xiao_esp32s3/FastLED/src` under whichever working tree
// has been built, since a fresh git worktree carries no .pio of its own:
//
//   FASTLED=../.pio/libdeps/seeed_xiao_esp32s3/FastLED/src
//   g++ -std=gnu++17 -I $FASTLED \
//       tests/golden/gen_fastled_vectors.cpp $FASTLED/hsv2rgb.cpp \
//       -o /tmp/gen_fastled_vectors
//   /tmp/gen_fastled_vectors > tests/golden/fastled_vectors.json
//
// The host build takes the same branches the ESP32 does: neither is AVR, so
// SCALE8_C is 1 in both, and FASTLED_SCALE8_FIXED is 1 either way.
#include <cstdio>
#include <cmath>
#include "FastLED.h"

// main .cpp: the only place the user's units meet FastLED's 8 bit ones.
static int hueByte(int degrees) { return (int)((degrees * 255L + 179) / 359); }
static int satByte(int percent) { return (int)((percent * 255L + 50) / 100); }

// LedDriverWS2812FastLED::_gammaScale()
static int gammaScale(int percent)
{
    if (percent <= 0) return 0;
    if (percent >= 100) return 255;
    long value = lroundf(255.0f * powf(percent / 100.0f, 2.2f));
    if (value < 1) value = 1;
    return (int)value;
}

// LedDriverWS2812FastLED::_brightnessScaleColor()
static int scaleColor(int part, int scaled)
{
    return (part * scaled + 127) / 255;
}

int main()
{
    printf("{\n");
    printf("  \"note\": \"generated by tests/golden/gen_fastled_vectors.cpp against FastLED 3.9.15\",\n");
    printf("  \"fastled\": \"3.9.15\",\n");

    // CHSV -> CRGB over the whole hue wheel at the saturations that matter,
    // with value fixed at 255 the way the display colour is written.
    printf("  \"rainbow\": [\n");
    const int sats[] = {0, 1, 32, 64, 128, 200, 254, 255};
    bool first = true;
    for (int s = 0; s < 8; s++)
    {
        for (int hue = 0; hue < 256; hue++)
        {
            CRGB c = CHSV((uint8_t)hue, (uint8_t)sats[s], 255);
            printf("%s    [%d, %d, 255, %d, %d, %d]", first ? "" : ",\n",
                   hue, sats[s], c.r, c.g, c.b);
            first = false;
        }
    }
    // The value branch as well. The display colour never uses it - the
    // brightness is applied per channel afterwards - but the corner LEDs do,
    // and a reimplementation that stops at sat is only half the function.
    const int vals[] = {0, 1, 7, 55, 128, 254};
    const int hues[] = {0, 43, 96, 140, 160, 200, 255};
    for (int v = 0; v < 6; v++)
        for (int h = 0; h < 7; h++)
        {
            CRGB c = CHSV((uint8_t)hues[h], 255, (uint8_t)vals[v]);
            printf(",\n    [%d, 255, %d, %d, %d, %d]", hues[h], vals[v], c.r, c.g, c.b);
        }
    printf("\n  ],\n");

    // The clock's own colour, degree by degree: hue 0..359 and the saturations
    // the web UI offers, through the integer conversion in `main .cpp` and
    // then through the wheel.
    printf("  \"display\": [\n");
    const int satPercents[] = {0, 20, 50, 80, 100};
    first = true;
    for (int sp = 0; sp < 5; sp++)
        for (int deg = 0; deg < 360; deg++)
        {
            CRGB c = CHSV((uint8_t)hueByte(deg), (uint8_t)satByte(satPercents[sp]), 255);
            printf("%s    [%d, %d, %d, %d, %d]", first ? "" : ",\n",
                   deg, satPercents[sp], c.r, c.g, c.b);
            first = false;
        }
    printf("\n  ],\n");

    // _gammaScale(), in the firmware's own float arithmetic.
    printf("  \"gamma\": [");
    for (int p = 0; p <= 101; p++) printf("%s%d", p ? ", " : "", gammaScale(p));
    printf("],\n");

    // _brightnessScaleColor(): what one channel of the display colour is
    // driven at once the brightness has been applied.
    printf("  \"channelDrive\": [\n");
    const int parts[] = {0, 1, 12, 85, 113, 170, 171, 254, 255};
    first = true;
    for (int i = 0; i < 9; i++)
        for (int p = 0; p <= 100; p += 5)
        {
            int scaled = gammaScale(p);
            printf("%s    [%d, %d, %d]", first ? "" : ",\n",
                   parts[i], scaled, scaleColor(parts[i], scaled));
            first = false;
        }
    printf("\n  ]\n}\n");
    return 0;
}
